// SPDX-License-Identifier: GPL-2.0-only
/* Exact Rev05 battery table. Telemetry only; no charging policy or trips. */
&{/i2c-fuelgauge/fuelgauge@71} {
	io-channels = <&pm8937_vadc VADC_P_MUX4_1_1>;
	io-channel-names = "battery-thermistor";
	samsung,adc-codes = <0x658d 0x665a 0x674f 0x6882 0x69e1 0x6b81 0x6d82 0x6fbd 0x724f 0x7536 0x785f 0x7c2b 0x7fe7 0x83e7 0x8832 0x8c57 0x906e 0x9421 0x979f 0x9a92 0x9d3f 0x9f76 0xa13a>;
	samsung,temperatures-decicelsius = <0x384 0x352 0x320 0x2ee 0x2bc 0x28a 0x258 0x226 0x1f4 0x1c2 0x190 0x15e 0x12c 0xfa 0xc8 0x96 0x64 0x32 0x00 0xffffffce 0xffffff9c 0xffffff6a 0xffffff38>;
};
